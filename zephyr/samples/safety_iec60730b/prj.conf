## CMakeLists.txt
```
# SPDX-License-Identifier: Apache-2.0

cmake_minimum_required(VERSION 3.20.0)
find_package(Zephyr REQUIRED HINTS $ENV{ZEPHYR_BASE})
project(safety_blinky)

target_include_directories(app PRIVATE src/)
target_sources(app PRIVATE
    src/main.c
    src/safety_tests.c
)
```

## Kconfig
```
# Copyright 2025 NXP
# SPDX-License-Identifier: Apache-2.0

mainmenu "Safety iec60730b sample application"

config APP_SAFETY_THREAD_STACK_SIZE
	int "Safety test thread stack size"
	default 1024
	help
	  Stack size in bytes for the safety test thread.
	  This thread runs periodic safety tests and monitors system health.
	  Increase this value if the safety tests require more stack space.

config APP_SAFETY_THREAD_PRIORITY
	int "Safety test thread priority"
	default -16 
	help
	  Priority level for the safety test thread.
	  Lower values indicate higher priority.
	  By default set to the absolute highest priority -16 for critical safety functions.

config APP_SAFETY_PERIOD_MS
	int "Safety test execution period in milliseconds"
	default 1000
	help
	  Time period in milliseconds between safety test executions.
	  This determines how frequently the safety tests are run.
	  Shorter periods provide faster error detection but consume more CPU.
	  Longer periods reduce CPU usage but may delay error detection.

config APP_SAFETY_LOG_LEVEL
	int "Safety tests log level"
	default 3
	range 0 4
	depends on LOG
	help
	  Sets the log level for the safety tests module.
	  Levels: 0=OFF, 1=ERROR, 2=WARNING, 3=INFO, 4=DEBUG

choice APP_SAFETY_ERROR_ACTION
	prompt "Safety Error Action"
	default APP_SAFETY_ERROR_ACTION_INFINITE_LOOP
	help
	  Select the action to take when a safety error is detected.

config APP_SAFETY_ERROR_ACTION_INFINITE_LOOP
	bool "Infinite Loop"
	help
	  When a safety error is detected, disable interrupts and enter an infinite loop,
	  The system will be stuck in a loop, preventing further execution
	  while maintaining processor activity. This can be useful for
	  debugging or when a controlled hang is preferred over a no action.

config APP_SAFETY_ERROR_ACTION_RESET
	bool "System Reset"
	help
	  When a safety error is detected, immediately perform a cold system reset.
	  This allows for quick recovery from safety violations.

endchoice

config APP_SAFETY_TASK_WATCHDOG
    bool "Enable Safety Task Watchdog"
    default y
    depends on TASK_WDT
    help
      Enable task watchdog for safety monitoring. The task watchdog
      monitors the safety test thread and triggers a callback if
      the thread fails to feed the watchdog within the specified timeout.
      This provides an additional safety mechanism to detect thread
      failures or system hangs.

if APP_SAFETY_TASK_WATCHDOG

config APP_SAFETY_TASK_WATCHDOG_TIMEOUT_MS
    int "Task watchdog timeout in milliseconds"
    default 10000
    help
      Timeout value for the safety task watchdog in milliseconds.
      This should be larger than CONFIG_APP_SAFETY_TESTS_PERIOD_MS
      to allow for test execution time. If the safety thread doesn't
      feed the watchdog within this time, the callback will be triggered.

endif # APP_SAFETY_TASK_WATCHDOG

source "Kconfig.zephyr"
```

## sample.yaml
```
sample:
  name: Safety iec60730b Sample
tests:
  sample.safety.iec60730b:
    tags:
      - safety
    integration_platforms:
      - frdm_rw612
```

## prj.conf
```kconfig
# Enable GPIO driver support, used by the blinky sample
CONFIG_GPIO=y

# Enable IEC 60730 Class B safety library
CONFIG_SAFETY_IEC60730B=y

# Enable task watchdog
CONFIG_TASK_WDT=y
CONFIG_WATCHDOG=y
#CONFIG_WDT_LOG_LEVEL_DBG=y

# Enable logging
CONFIG_LOG=y
CONFIG_LOG_MODE_IMMEDIATE=y

# Enable thread monitoring for debugger RTOS view support
CONFIG_THREAD_MONITOR=y
CONFIG_THREAD_NAME=y
CONFIG_THREAD_STACK_INFO=y
CONFIG_THREAD_RUNTIME_STATS=y
CONFIG_INIT_STACKS=y
CONFIG_DEBUG_THREAD_INFO=y
```

## src/main.c
```c
/*
 * Copyright (c) 2016 Intel Corporation
 * Copyright 2025 NXP
 * SPDX-License-Identifier: Apache-2.0
 */

#include "safety_tests.h"

#include <stdio.h>
#include <zephyr/kernel.h>
#include <zephyr/drivers/gpio.h>


/* 1000 msec = 1 sec */
#define SLEEP_TIME_MS   1000

/* The devicetree node identifier for the "led0" alias. */
#define LED0_NODE DT_ALIAS(led0)

/*
 * A build error on this line means your board is unsupported.
 * See the sample documentation for information on how to fix this.
 */
static const struct gpio_dt_spec led = GPIO_DT_SPEC_GET(LED0_NODE, gpios);

static safety_common_t g_sSafetyCommon;

int main(void)
{
	int ret;
	bool led_state = true;

	if (!gpio_is_ready_dt(&led)) {
		return 0;
	}

	ret = gpio_pin_configure_dt(&led, GPIO_OUTPUT_ACTIVE);
	if (ret < 0) {
		return 0;
	}

#ifdef CONFIG_SAFETY_IEC60730B_TEST_CPU_REG
	/* CPU test after reset */
	SafetyCpuAfterResetTest(&g_sSafetyCommon);
#endif

	while (1) {
		ret = gpio_pin_toggle_dt(&led);
		if (ret < 0) {
			return 0;
		}

		led_state = !led_state;
		printf("LED state: %s\n", led_state ? "ON" : "OFF");
		k_msleep(SLEEP_TIME_MS);

	#ifdef CONFIG_SAFETY_IEC60730B_TEST_CPU_REG
		/* Interruptable CPU registers test */
		SafetyCpuBackgroundTest(&g_sSafetyCommon);
	#endif

	}
	return 0;
}
```

## src/safety_tests.c
```c
/*
 * Copyright 2025 NXP
 * SPDX-License-Identifier: Apache-2.0
 */

#include <safety_tests.h>
#include <zephyr/kernel.h>
#include <zephyr/logging/log.h>

#include <zephyr/device.h>
#include <zephyr/drivers/watchdog.h>
#include <zephyr/task_wdt/task_wdt.h>
#include <zephyr/sys/reboot.h>

/* TBD:
    - Add other safety tests.
*/

/*******************************************************************************
* Variables
******************************************************************************/
int safety_error_code; /* Global error code. */

static int safety_init(void);
static void safety_thread(void *arg1, void *arg2, void *arg3);
static void safety_error_handling(int error_code);

#ifdef CONFIG_APP_SAFETY_TASK_WATCHDOG

static void safety_task_wdt_callback(int channel_id, void *user_data);

#if DT_NODE_HAS_STATUS_OKAY(DT_ALIAS(watchdog0))
#define WDT_NODE DT_ALIAS(watchdog0)
#else
#define WDT_NODE DT_INVALID_NODE
#endif

/* Task watchdog channel ID for safety tests monitoring. */
int safety_task_wdt_id;

#endif /* CONFIG_APP_SAFETY_TASK_WATCHDOG */

/*!
 * @brief Register safety_tests module for logging
 */
LOG_MODULE_REGISTER(safety, CONFIG_APP_SAFETY_LOG_LEVEL);

/*!
 * @brief   System initialization hook for safety tests after reset.
 *
 *          This system initialization call ensures that IEC 60730-B compliant safety tests
 *          are executed automatically during system startup after the kernel is initialized.
 *          The safety tests run at the APPLICATION priority level to verify system integrity
 *          before normal application execution begins.
 */
SYS_INIT(safety_init, APPLICATION, CONFIG_KERNEL_INIT_PRIORITY_DEFAULT);

/*!
 * @brief   Safety test thread definition and automatic startup configuration.
 */
K_THREAD_DEFINE(safety, CONFIG_APP_SAFETY_THREAD_STACK_SIZE,
                safety_thread, NULL, NULL, NULL,
                CONFIG_APP_SAFETY_THREAD_PRIORITY, 0, 0);

/*******************************************************************************
 * Code
 ******************************************************************************/

/*!
 * @brief   Safety tests initialization function executed during system startup.
 */
static int safety_init(void)
{
    int result;

#ifdef CONFIG_APP_SAFETY_TASK_WATCHDOG
    const struct device *const hw_wdt_dev = DEVICE_DT_GET_OR_NULL(WDT_NODE);

    if (!device_is_ready(hw_wdt_dev)) {
        LOG_WRN("Hardware watchdog not ready");
        result = task_wdt_init(NULL);
    } else {
        result = task_wdt_init(hw_wdt_dev);
    }

    if (result != 0) {
        LOG_ERR("task wdt init failure: %d\n", result);
        safety_error_handling(-1);
    }

    /* Add a new task watchdog channel with the safety callback function */
    safety_task_wdt_id = task_wdt_add(CONFIG_APP_SAFETY_TASK_WATCHDOG_TIMEOUT_MS, safety_task_wdt_callback, NULL);
    if (safety_task_wdt_id < 0) {
        LOG_ERR("Failed to add task WDT channel");
        safety_error_handling(-1);
    }
    LOG_INF("Task WDT channel %d added with timeout %d ms", safety_task_wdt_id, CONFIG_APP_SAFETY_TASK_WATCHDOG_TIMEOUT_MS);
#endif /* CONFIG_APP_SAFETY_TASK_WATCHDOG */

#ifdef CONFIG_SAFETY_IEC60730B_TEST_CPU_REG
    LOG_INF("Executing CPU after reset test");
    result = sf_cpu_reg_test();
    if(result != 0){
        safety_error_handling(result);
    }
#endif

    /* === ADD YOUR SAFETY TESTS HERE === */

#ifdef CONFIG_APP_SAFETY_TASK_WATCHDOG
        task_wdt_feed(safety_task_wdt_id);
#endif /* CONFIG_APP_SAFETY_TASK_WATCHDOG */

    return 0;
}

/*!
 * @brief   Safety test thread function that executes periodic safety tests.
 */
static void safety_thread(void *arg1, void *arg2, void *arg3)
{
    ARG_UNUSED(arg1);
    ARG_UNUSED(arg2);
    ARG_UNUSED(arg3);

    int result;

    LOG_INF("Safety test thread started automatically");

    /* Thread function runs indefinitely */
    while (1) {

#ifdef CONFIG_SAFETY_IEC60730B_TEST_CPU_REG
        /* CPU registers tests */
        LOG_INF("Executing CPU background test");
        result = sf_cpu_reg_test();
        if(result != 0){
            safety_error_handling(result);
        }
#endif

        /* === ADD YOUR SAFETY TESTS HERE ==*/

#ifdef CONFIG_APP_SAFETY_TASK_WATCHDOG
        task_wdt_feed(safety_task_wdt_id);
#endif /* CONFIG_APP_SAFETY_TASK_WATCHDOG */

        /* Sleep before next iteration */
        k_msleep(CONFIG_APP_SAFETY_PERIOD_MS);
    }
}

/*!
 * @brief   Handling with a safety error.
 */
static void safety_error_handling(int error_code)
{
    safety_error_code = error_code;
    LOG_ERR("Safety error detected: 0x%08x", safety_error_code);

#ifdef CONFIG_APP_SAFETY_ERROR_ACTION_INFINITE_LOOP
    LOG_INF("Entering infinite loop");
    (void)irq_lock(); /* Disable interrupts */
    while (1){
#ifdef CONFIG_APP_SAFETY_TASK_WATCHDOG
        task_wdt_feed(safety_task_wdt_id);
#endif /* CONFIG_APP_SAFETY_TASK_WATCHDOG */
    }
#elif defined(CONFIG_APP_SAFETY_ERROR_ACTION_RESET)
    LOG_INF("Performing immediate cold reset");
    sys_reboot(SYS_REBOOT_COLD);
#endif
}

#ifdef CONFIG_APP_SAFETY_TASK_WATCHDOG
static void safety_task_wdt_callback(int channel_id, void *user_data)
{
    ARG_UNUSED(user_data);
    LOG_WRN("Task watchdog channel %d timeout", channel_id);

    safety_error_handling(-1);
}
#endif
```

## src/safety_tests.h
```c
/*
 * Copyright 2025 NXP
 * SPDX-License-Identifier: Apache-2.0
 */

#ifndef _SAFETY_CM33_IMXRT_H_
#define _SAFETY_CM33_IMXRT_H_

#include "iec60730b.h"
#include "iec60730b_core.h"

/*******************************************************************************
 * Definitions
 ******************************************************************************/
/*!
 * @name Safety test error flags
 * @brief Error flag definitions for IEC 60730 Class B safety tests
 * 
 * These flags are used in the safetyErrors field of the safety_common_t structure
 * to indicate which safety tests have failed. Multiple flags can be combined using
 * bitwise OR operations to represent multiple test failures.
 */
#define CPU_TEST_ERROR           0x1     /* CPU test fault flag */
#define FLASH_TEST_ERROR         0x2     /* Flash test fault flag */
#define RAM_TEST_ERROR           0x4     /* RAM test fault flag */
#define STACK_TEST_ERROR         0x8     /* Stack test fault flag */
#define CLOCK_TEST_ERROR         0x10    /* Clock test fault flag */
#define PC_TEST_ERROR            0x20    /* Program counter test fault flag */
#define CPU_PRIMASK_ERROR        0x40    /* PRIMASK test fault flag */
#define CPU_REGISTERS_ERROR      0x80    /* CPU registers test fault flag */
#define CPU_NONSTACKED_ERROR     0x100   /* non-stacked CPU test fault flag */
#define CPU_FLOAT_1_ERROR        0x200   /* floating point registers test fault flag */
#define CPU_FLOAT_2_ERROR        0x400   /* floating point registers test fault flag */
#define CPU_CONTROL_ERROR        0x800   /* CONTROL register test fault flag */
#define CPU_SPECIAL_ERROR        0x1000  /* special CPU registers test fault flag */

/*!
 * @brief Safety common structure containing test results and error flags
 * 
 * This structure holds the safety test results and error status for various
 * IEC 60730 Class B safety tests including CPU register tests, floating point
 * unit tests, and TrustZone tests when enabled.
 */
typedef struct _safety_common
{
    uint32_t safetyErrors;          /*!< Bitfield containing safety test error flags */
#ifdef CONFIG_SAFETY_IEC60730B_TEST_CPU_REG
    uint32_t CPU_primask_test_result;   /*!< Result of PRIMASK register safety test */
    uint32_t CPU_reg_test_result;       /*!< Result of CPU registers safety test */
    uint32_t CPU_non_stacked_test_result; /*!< Result of non-stacked CPU registers safety test */
    uint32_t CPU_control_test_result;   /*!< Result of CONTROL register safety test */
    uint32_t CPU_special_test_result;   /*!< Result of special CPU registers safety test */
#ifdef CONFIG_SAFETY_IEC60730B_TEST_CPU_REG_FPU
    uint32_t CPU_fpu_test_result;       /*!< Result of floating point unit safety test */
    uint32_t CPU_float_test_1_result;   /*!< Result of floating point registers safety test 1 */
    uint32_t CPU_float_test_2_result;   /*!< Result of floating point registers safety test 2 */
#endif    
#ifdef CONFIG_SAFETY_IEC60730B_TEST_CPU_REG_TZ
    uint32_t CPU_primask_ns_test_result;    /*!< Result of non-secure PRIMASK register safety test */
    uint32_t CPU_control_ns_test_result;    /*!< Result of non-secure CONTROL register safety test */
    uint32_t CPU_special_ns_test_result;    /*!< Result of non-secure special CPU registers safety test */
#endif
#endif /* CONFIG_SAFETY_IEC60730B_TEST_CPU_REG */
    //TBD uint32_t fastIsrSafetySwitch;
    //TBD uint32_t CLOCK_test_result;
    //TBD uint32_t FLASH_test_result;
    //TBD uint32_t RAM_test_result;
    //TBD uint32_t PC_test_result;
    //TBD uint32_t STACK_test_result;
    //TBD uint32_t refClkFreq;
} safety_common_t;

#ifdef __cplusplus
extern "C" {
#endif

/*******************************************************************************
 * API
 ******************************************************************************/
/*!
 * @brief Performs CPU safety tests that should be executed after system reset
 * 
 * This function executes IEC 60730 Class B CPU safety tests that are typically
 * run during system initialization after a reset to verify CPU functionality
 * before normal operation begins.
 * 
 * @param psSafetyCommon Pointer to safety common structure to store test results
 */
void SafetyCpuAfterResetTest(safety_common_t *psSafetyCommon);
/*!
 * @brief Performs CPU safety tests that should be executed during background operation
 * 
 * This function executes IEC 60730 Class B CPU safety tests that are typically
 * run periodically during normal system operation to continuously verify CPU 
 * functionality and detect potential faults.
 * 
 * @param psSafetyCommon Pointer to safety common structure to store test results
 */
void SafetyCpuBackgroundTest(safety_common_t *psSafetyCommon);

/*!
 * @brief Handles safety errors detected during IEC 60730 Class B tests
 * 
 * This function processes safety errors that occur during the execution of
 * IEC 60730 Class B safety tests and implements appropriate error handling
 * procedures based on the detected fault conditions.
 * 
 * @param psSafetyCommon Pointer to safety common structure containing test results and error information
 */
void SafetyErrorHandling(safety_common_t *psSafetyCommon);

#ifdef __cplusplus
}
#endif

#endif /* _SAFETY_CM33_IMXRT_H_ */
```

## src/safety_tests_cm0.c
```c
/*
 * Copyright 2025 NXP
 * SPDX-License-Identifier: Apache-2.0
 */

#include "safety_tests.h"

/*!
 * @brief   After-reset CPU registers test.
 *
 *          This function calls the CPU test functions from IEC60730 library.
 *          All the registers are tested at once.
 *          In case of incorrect flash test result, it updates the safetyErrors variable accordingly.
 *          See IEC60730 library documentation for CPU errors handling !
 *
 * @param   psSafetyCommon - The pointer of the Common Safety structure
 *
 * @return  None
 */
void SafetyCpuAfterResetTest(safety_common_t *psSafetyCommon)
{
    /* stacked CPU registers */
    psSafetyCommon->CPU_reg_test_result = FS_CM0_CPU_Register();
    if (psSafetyCommon->CPU_reg_test_result == FS_FAIL_CPU_REGISTER)
    {
        psSafetyCommon->safetyErrors |= CPU_REGISTERS_ERROR;
        SafetyErrorHandling(psSafetyCommon);
    }
    /* non-stacked CPU registers */
    psSafetyCommon->CPU_non_stacked_test_result = FS_CM0_CPU_NonStackedRegister();
    if (psSafetyCommon->CPU_non_stacked_test_result == FS_FAIL_CPU_NONSTACKED_REGISTER)
    {
        psSafetyCommon->safetyErrors |= CPU_NONSTACKED_ERROR;
        SafetyErrorHandling(psSafetyCommon);
    }
    /* CONTROL */
    psSafetyCommon->CPU_control_test_result = FS_CM0_CPU_Control();
    if (psSafetyCommon->CPU_control_test_result == FS_FAIL_CPU_CONTROL)
    {
        psSafetyCommon->safetyErrors |= CPU_CONTROL_ERROR;
        SafetyErrorHandling(psSafetyCommon);
    }
    /* SP main */
    FS_CM0_CPU_SPmain();

    /* SP process */
    FS_CM0_CPU_SPprocess();

    /* PRIMASK */
    psSafetyCommon->CPU_primask_test_result = FS_CM0_CPU_Primask();
    if (psSafetyCommon->CPU_primask_test_result == FS_FAIL_CPU_PRIMASK)
    {
        psSafetyCommon->safetyErrors |= CPU_PRIMASK_ERROR;
        SafetyErrorHandling(psSafetyCommon);
    }
}

/*!
 * @brief   Interruptible test of CPU registers.
 *
 *          This function calls the CPU test functions from IEC60730 library.
 *          The function can be called from the background loop.
 *          In case of incorrect flash test result, it updates the safetyErrors variable accordingly.
 *          See IEC60730 library documentation for CPU errors handling !
 *
 * @param   psSafetyCommon - The pointer of the Common Safety structure
 *
 * @return  None
 */
void SafetyCpuBackgroundTest(safety_common_t *psSafetyCommon)
{
    psSafetyCommon->CPU_reg_test_result = FS_CM0_CPU_Register();
    if (psSafetyCommon->CPU_reg_test_result == FS_FAIL_CPU_REGISTER)
    {
        psSafetyCommon->safetyErrors |= CPU_REGISTERS_ERROR;
        SafetyErrorHandling(psSafetyCommon);
    }

    psSafetyCommon->CPU_non_stacked_test_result = FS_CM0_CPU_NonStackedRegister();
    if (psSafetyCommon->CPU_non_stacked_test_result == FS_FAIL_CPU_NONSTACKED_REGISTER)
    {
        psSafetyCommon->safetyErrors |= CPU_NONSTACKED_ERROR;
        SafetyErrorHandling(psSafetyCommon);
    }
}
```

## src/safety_tests_cm33.c
```c
/*
 * Copyright 2025 NXP
 * SPDX-License-Identifier: Apache-2.0
 */

#include "safety_tests.h"

/*!
 * @brief   After-reset CPU registers test.
 *
 *          This function calls the CPU test functions from IEC60730 library.
 *          All the registers are tested at once.
 *          In case of incorrect flash test result, it updates the safetyErrors variable accordingly.
 *          See IEC60730 library documentation for CPU errors handling !
 *
 * @param   psSafetyCommon - The pointer of the Common Safety structure
 *
 * @return  None
 */
void SafetyCpuAfterResetTest(safety_common_t *psSafetyCommon)
{
#ifdef CONFIG_SAFETY_IEC60730B_TEST_CPU_REG_DSP
    /* stacked CPU registers */
    psSafetyCommon->CPU_reg_test_result = FS_CM33_CPU_Register();
    if (psSafetyCommon->CPU_reg_test_result == FS_FAIL_CPU_REGISTER)
    {
        psSafetyCommon->safetyErrors |= CPU_REGISTERS_ERROR;
        SafetyErrorHandling(psSafetyCommon);
    }
#else   
    /* stacked CPU registers */
    psSafetyCommon->CPU_reg_test_result = FS_CM33_CPU_Register_NDSP();
    if (psSafetyCommon->CPU_reg_test_result == FS_FAIL_CPU_REGISTER)
    {
        psSafetyCommon->safetyErrors |= CPU_REGISTERS_ERROR;
        SafetyErrorHandling(psSafetyCommon);
    }
#endif
    
    /* non-stacked CPU registers */
    psSafetyCommon->CPU_non_stacked_test_result = FS_CM33_CPU_NonStackedRegister();
    if (psSafetyCommon->CPU_non_stacked_test_result == FS_FAIL_CPU_NONSTACKED_REGISTER)
    {
        psSafetyCommon->safetyErrors |= CPU_NONSTACKED_ERROR;
        SafetyErrorHandling(psSafetyCommon);
    }
    
    /* PRIMASK Secure */
    psSafetyCommon->CPU_primask_test_result = FS_CM33_CPU_Primask_S();
    if (psSafetyCommon->CPU_primask_test_result == FS_FAIL_CPU_PRIMASK)
    {
        psSafetyCommon->safetyErrors |= CPU_PRIMASK_ERROR;
        SafetyErrorHandling(psSafetyCommon);
    }
    
#ifdef CONFIG_SAFETY_IEC60730B_TEST_CPU_REG_TZ
    /* PRIMASK Non-Secure */
    psSafetyCommon->CPU_primask_ns_test_result = FS_CM33_CPU_Primask_NS();
    if (psSafetyCommon->CPU_primask_ns_test_result == FS_FAIL_CPU_PRIMASK)
    {
        psSafetyCommon->safetyErrors |= CPU_PRIMASK_ERROR;
        SafetyErrorHandling(psSafetyCommon);
    }
#endif
    
    /* SP main Secure */
    FS_CM33_CPU_SPmain_S();
    
#ifdef CONFIG_SAFETY_IEC60730B_TEST_CPU_REG_TZ
    /* SP main Non-Secure */
    FS_CM33_CPU_SPmain_NS();
#endif

    /* SP main limit Secure */
    FS_CM33_CPU_SPmain_Limit_S();
    
#ifdef CONFIG_SAFETY_IEC60730B_TEST_CPU_REG_TZ
    /* SP main limit Non-Secure */
    FS_CM33_CPU_SPmain_Limit_NS();
#endif

    /* SP process Secure */
    FS_CM33_CPU_SPprocess_S();
    
#ifdef CONFIG_SAFETY_IEC60730B_TEST_CPU_REG_TZ
    /* SP process Non-Secure */
    FS_CM33_CPU_SPprocess_NS();
#endif

    /* SP process limit Secure */
    FS_CM33_CPU_SPprocess_Limit_S();
    
#ifdef CONFIG_SAFETY_IEC60730B_TEST_CPU_REG_TZ
    /* SP process limit Non-Secure */
    FS_CM33_CPU_SPprocess_Limit_NS();
#endif

    psSafetyCommon->CPU_control_test_result = FS_CM33_CPU_Control_S();
    if (psSafetyCommon->CPU_control_test_result == FS_FAIL_CPU_CONTROL)
    {
        psSafetyCommon->safetyErrors |= CPU_CONTROL_ERROR;
        SafetyErrorHandling(psSafetyCommon);
    }
    
#ifdef CONFIG_SAFETY_IEC60730B_TEST_CPU_REG_TZ
    /* CONTROL Non-Secure */
    psSafetyCommon->CPU_control_ns_test_result = FS_CM33_CPU_Control_NS();
    if (psSafetyCommon->CPU_control_ns_test_result == FS_FAIL_CPU_CONTROL)
    {
        psSafetyCommon->safetyErrors |= CPU_CONTROL_ERROR;
        SafetyErrorHandling(psSafetyCommon);
    }
#endif

    /* Special Secure */
    psSafetyCommon->CPU_special_test_result = FS_CM33_CPU_Special8PriorityLevels_S();
    if (psSafetyCommon->CPU_special_test_result == FS_FAIL_CPU_SPECIAL)
    {
        psSafetyCommon->safetyErrors |= CPU_SPECIAL_ERROR;
        SafetyErrorHandling(psSafetyCommon);
    }
    
#ifdef CONFIG_SAFETY_IEC60730B_TEST_CPU_REG_TZ
    /* Special Non-Secure */
    psSafetyCommon->CPU_special_ns_test_result = FS_CM33_CPU_Special8PriorityLevels_NS();
    if (psSafetyCommon->CPU_special_ns_test_result == FS_FAIL_CPU_SPECIAL)
    {
        psSafetyCommon->safetyErrors |= CPU_SPECIAL_ERROR;
        SafetyErrorHandling(psSafetyCommon);
    }
#endif

#ifdef CONFIG_SAFETY_IEC60730B_TEST_CPU_REG_FPU
    psSafetyCommon->CPU_fpu_test_result = FS_CM33_CPU_Float1();
    if (psSafetyCommon->CPU_fpu_test_result == FS_FAIL_CPU_FLOAT_1)
    {
        psSafetyCommon->safetyErrors |= CPU_FLOAT_1_ERROR;
        SafetyErrorHandling(psSafetyCommon);
    }

    psSafetyCommon->CPU_fpu_test_result = FS_CM33_CPU_Float2();
    if (psSafetyCommon->CPU_fpu_test_result == FS_FAIL_CPU_FLOAT_2)
    {
        psSafetyCommon->safetyErrors |= CPU_FLOAT_2_ERROR;
        SafetyErrorHandling(psSafetyCommon);
    }
#endif
}

/*!
 * @brief   Interruptible test of CPU registers.
 *
 *          This function calls the CPU test functions from IEC60730 library.
 *          The function can be called from the background loop.
 *          In case of incorrect flash test result, it updates the safetyErrors variable accordingly.
 *          See IEC60730 library documentation for CPU errors handling !
 *
 * @param   psSafetyCommon - The pointer of the Common Safety structure
 *
 * @return  None
 */
void SafetyCpuBackgroundTest(safety_common_t *psSafetyCommon)
{
#ifdef CONFIG_SAFETY_IEC60730B_TEST_CPU_REG_DSP
    /* stacked CPU registers */
    psSafetyCommon->CPU_reg_test_result = FS_CM33_CPU_Register();
    if (psSafetyCommon->CPU_reg_test_result == FS_FAIL_CPU_REGISTER)
    {
        psSafetyCommon->safetyErrors |= CPU_REGISTERS_ERROR;
        SafetyErrorHandling(psSafetyCommon);
    }
#else   
    /* stacked CPU registers */
    psSafetyCommon->CPU_reg_test_result = FS_CM33_CPU_Register_NDSP();
    if (psSafetyCommon->CPU_reg_test_result == FS_FAIL_CPU_REGISTER)
    {
        psSafetyCommon->safetyErrors |= CPU_REGISTERS_ERROR;
        SafetyErrorHandling(psSafetyCommon);
    }
#endif

    psSafetyCommon->CPU_non_stacked_test_result = FS_CM33_CPU_NonStackedRegister();
    if (psSafetyCommon->CPU_non_stacked_test_result == FS_FAIL_CPU_NONSTACKED_REGISTER)
    {
        psSafetyCommon->safetyErrors |= CPU_NONSTACKED_ERROR;
        SafetyErrorHandling(psSafetyCommon);
    }
    
#ifdef CONFIG_SAFETY_IEC60730B_TEST_CPU_REG_FPU
    psSafetyCommon->CPU_fpu_test_result = FS_CM33_CPU_Float1();
    if (psSafetyCommon->CPU_fpu_test_result == FS_FAIL_CPU_FLOAT_1)
    {
        psSafetyCommon->safetyErrors |= CPU_FLOAT_1_ERROR;
        SafetyErrorHandling(psSafetyCommon);
    }

    psSafetyCommon->CPU_fpu_test_result = FS_CM33_CPU_Float2();
    if (psSafetyCommon->CPU_fpu_test_result == FS_FAIL_CPU_FLOAT_2)
    {
        psSafetyCommon->safetyErrors |= CPU_FLOAT_2_ERROR;
        SafetyErrorHandling(psSafetyCommon);
    }
#endif
}
```

## src/safety_tests_cm4_cm7.c
```c
/*
 * Copyright 2025 NXP
 * SPDX-License-Identifier: Apache-2.0
 */

#include "safety_tests.h"

/*!
 * @brief   After-reset CPU registers test.
 *
 *          This function calls the CPU test functions from IEC60730 library.
 *          All the registers are tested at once.
 *          In case of incorrect flash test result, it updates the safetyErrors variable accordingly.
 *          See IEC60730 library documentation for CPU errors handling !
 *
 * @param   psSafetyCommon - The pointer of the Common Safety structure
 *
 * @return  None
 */
void SafetyCpuAfterResetTest(safety_common_t *psSafetyCommon)
{
    /* stacked CPU registers */
    psSafetyCommon->CPU_reg_test_result = FS_CM4_CM7_CPU_Register();
    if (psSafetyCommon->CPU_reg_test_result == FS_FAIL_CPU_REGISTER)
    {
        psSafetyCommon->safetyErrors |= CPU_REGISTERS_ERROR;
        SafetyErrorHandling(psSafetyCommon);
    }
    /* non-stacked CPU registers */
    psSafetyCommon->CPU_non_stacked_test_result = FS_CM4_CM7_CPU_NonStackedRegister();
    if (psSafetyCommon->CPU_non_stacked_test_result == FS_FAIL_CPU_NONSTACKED_REGISTER)
    {
        psSafetyCommon->safetyErrors |= CPU_NONSTACKED_ERROR;
        SafetyErrorHandling(psSafetyCommon);
    }
    /* CONTROL */
#ifdef CONFIG_SAFETY_IEC60730B_TEST_CPU_REG_FPU
    psSafetyCommon->CPU_control_test_result = FS_CM4_CM7_CPU_ControlFpu();
#else
    psSafetyCommon->CPU_control_test_result = FS_CM4_CM7_CPU_Control();
#endif

    if (psSafetyCommon->CPU_control_test_result == FS_FAIL_CPU_CONTROL)
    {
        psSafetyCommon->safetyErrors |= CPU_CONTROL_ERROR;
        SafetyErrorHandling(psSafetyCommon);
    }
    /* SP main */
    FS_CM4_CM7_CPU_SPmain();

    /* SP process */
    FS_CM4_CM7_CPU_SPprocess();

    /* PRIMASK */
    psSafetyCommon->CPU_primask_test_result = FS_CM4_CM7_CPU_Primask();
    if (psSafetyCommon->CPU_primask_test_result == FS_FAIL_CPU_PRIMASK)
    {
        psSafetyCommon->safetyErrors |= CPU_PRIMASK_ERROR;
        SafetyErrorHandling(psSafetyCommon);
    }
    /* Special CPU registers  */
    psSafetyCommon->CPU_special_test_result = FS_CM4_CM7_CPU_Special();
    if (psSafetyCommon->CPU_special_test_result == FS_FAIL_CPU_SPECIAL)
    {
        psSafetyCommon->safetyErrors |= CPU_SPECIAL_ERROR;
        SafetyErrorHandling(psSafetyCommon);
    }
    /* group 1 of FPU registers */
#ifdef CONFIG_SAFETY_IEC60730B_TEST_CPU_REG_FPU
    psSafetyCommon->CPU_float_test_1_result = FS_CM4_CM7_CPU_Float1();
    if (psSafetyCommon->CPU_float_test_1_result == FS_FAIL_CPU_FLOAT_1)
    {
        psSafetyCommon->safetyErrors |= CPU_FLOAT_1_ERROR;
        SafetyErrorHandling(psSafetyCommon);
    }
    /* group 2 of FPU registers */
    psSafetyCommon->CPU_float_test_2_result = FS_CM4_CM7_CPU_Float2();
    if (psSafetyCommon->CPU_float_test_2_result == FS_FAIL_CPU_FLOAT_2)
    {
        psSafetyCommon->safetyErrors |= CPU_FLOAT_2_ERROR;
        SafetyErrorHandling(psSafetyCommon);
    }
#endif
}

/*!
 * @brief   Interruptible test of CPU registers.
 *
 *          This function calls the CPU test functions from IEC60730 library.
 *          The function can be called from the background loop.
 *          In case of incorrect flash test result, it updates the safetyErrors variable accordingly.
 *          See IEC60730 library documentation for CPU errors handling !
 *
 * @param   psSafetyCommon - The pointer of the Common Safety structure
 *
 * @return  None
 */
void SafetyCpuBackgroundTest(safety_common_t *psSafetyCommon)
{
    psSafetyCommon->CPU_reg_test_result = FS_CM4_CM7_CPU_Register();
    if (psSafetyCommon->CPU_reg_test_result == FS_FAIL_CPU_REGISTER)
    {
        psSafetyCommon->safetyErrors |= CPU_REGISTERS_ERROR;
        SafetyErrorHandling(psSafetyCommon);
    }

    psSafetyCommon->CPU_non_stacked_test_result = FS_CM4_CM7_CPU_NonStackedRegister();
    if (psSafetyCommon->CPU_non_stacked_test_result == FS_FAIL_CPU_NONSTACKED_REGISTER)
    {
        psSafetyCommon->safetyErrors |= CPU_NONSTACKED_ERROR;
        SafetyErrorHandling(psSafetyCommon);
    }
#ifdef CONFIG_SAFETY_IEC60730B_TEST_CPU_REG_FPU
    psSafetyCommon->CPU_float_test_1_result = FS_CM4_CM7_CPU_Float1();
    if (psSafetyCommon->CPU_float_test_1_result == FS_FAIL_CPU_FLOAT_1)
    {
        psSafetyCommon->safetyErrors |= CPU_FLOAT_1_ERROR;
        SafetyErrorHandling(psSafetyCommon);
    }

    psSafetyCommon->CPU_float_test_2_result = FS_CM4_CM7_CPU_Float2();
    if (psSafetyCommon->CPU_float_test_2_result == FS_FAIL_CPU_FLOAT_2)
    {
        psSafetyCommon->safetyErrors |= CPU_FLOAT_2_ERROR;
        SafetyErrorHandling(psSafetyCommon);
    }
#endif
}
```
