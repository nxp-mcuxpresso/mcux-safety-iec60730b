## Kconfig
```kconfig
menu "Safety IEC60730b"

    config MCUX_COMPONENT_middleware.safety
        bool "safety library"

endmenu
```

## zephyr/Kconfig
```kconfig
# Copyright 2025 NXP
# SPDX-License-Identifier: Apache-2.0

menuconfig IEC60730B
    bool "Safety IEC60730B test library"
    help
      Enable the Safety IEC60730B test library.

if IEC60730B

    choice IEC60730B_HAL
        prompt "IEC60730B Hardware Abstraction Layer (HAL) Selection"
        default IEC60730B_HAL_NXP if SOC_FAMILY_MCXN || SOC_FAMILY_MCXW || SOC_FAMILY_MCXA || SOC_FAMILY_MCXC || \
                                     SOC_FAMILY_KINETIS || SOC_FAMILY_NXP_IMX || SOC_FAMILY_NXP_IMXRT || SOC_FAMILY_LPC || SOC_FAMILY_NXP_S32 || SOC_FAMILY_NXP_RW
        default IEC60730B_HAL_ZEPHYR
        help
          Select the Hardware Abstraction Layer (HAL) implementation for
          IEC60730B safety tests. Different HAL implementations provide
          platform-specific test implementations for various hardware vendors.

    config IEC60730B_HAL_NXP
        bool "IEC60730B NXP HAL"
        help
          Use NXP-specific Hardware Abstraction Layer implementation for
          IEC60730B safety tests. This HAL is backed by the NXP-precertified
          IEC 60730B safety library, which has been independently evaluated
          and certified for use in safety-critical applications. It provides
          optimized, certified test implementations for NXP microcontrollers
          including Cortex-M0+, Cortex-M4, Cortex-M7, and Cortex-M33 based
          devices.

    config IEC60730B_HAL_ZEPHYR
        bool "IEC60730B Zephyr HAL (EXPERIMENTAL)"
        help
          EXPERIMENTAL: Use generic Zephyr API-based Hardware Abstraction Layer
          implementation for IEC60730B safety tests. This provides portable test
          implementations using standard Zephyr APIs, suitable for any platform
          supported by Zephyr RTOS.

          WARNING: This HAL does NOT use any vendor-certified libraries. None of
          the code in this HAL has been certified against IEC 60730B or any other
          safety standard. Users are solely responsible for evaluating, validating,
          and certifying all code for their specific application and target platform
          before use in any safety-critical product.

    config IEC60730B_HAL_NONE
        bool "No IEC60730B HAL"
        help
          Do not use any vendor-specific HAL implementation. Only weak
          function implementations will be available, which return
          IEC60730B_TEST_NOT_SUPPORTED. This option is useful when
          implementing custom HAL.

    endchoice

    config IEC60730B_TEST_CPU
        bool "IEC60730B CPU registers test routines"
        default y
        help
          Enable CPU register test routines for the IEC60730B safety library.
          This test verifies the integrity of CPU core registers by
          writing test patterns and reading them back to detect
          stuck-at faults and other register-related failures.

    config IEC60730B_TEST_FPU
        bool "IEC60730B FPU registers test routines"
        default y
        depends on CPU_HAS_FPU
        select FPU
        help
          Enable Floating Point Unit (FPU) register test routines for
          the IEC60730B safety library. This test verifies the integrity of
          FPU registers by writing test patterns and reading them back
          to detect stuck-at faults in floating point registers.
          Requires FPU hardware support.

    config IEC60730B_TEST_PC
        bool "IEC60730B Program Counter test routines"
        default y
        help
          Enable Program Counter test routines for the IEC60730B safety library.
          The PC test verifies the proper execution flow and detects program counter
          corruption or unexpected jumps in code execution.

    config IEC60730B_TEST_RAM
        bool "IEC60730B RAM test routines"
        default y
        help
          Enable RAM test routines for the IEC60730B safety library.
          The RAM test verifies the integrity of system memory using various
          test patterns and algorithms to detect memory faults.

    config IEC60730B_TEST_FLASH
        bool "IEC60730B Flash Memory test routines"
        default y
        help
          Enable flash memory test routines for the IEC60730B safety library.
          This test verifies the integrity of flash memory contents
          using CRC methods.

    if IEC60730B_TEST_FLASH

    config IEC60730B_TEST_FLASH_CRC16
        bool "IEC60730B Flash CRC16 Algorithm"
        default y
        help
          Enable CRC16 (16-bit Cyclic Redundancy Check) algorithm for flash
          memory integrity testing. CRC16 provides good error detection
          capabilities with faster computation and lower memory overhead
          compared to CRC32. Suitable for most IEC 60730 Class B applications
          where flash memory size is moderate.

    config IEC60730B_TEST_FLASH_CRC32
        bool "IEC60730B Flash CRC32 Algorithm"
        default y
        help
          Enable CRC32 (32-bit Cyclic Redundancy Check) algorithm for flash
          memory integrity testing. CRC32 provides superior error detection
          capabilities compared to CRC16, making it suitable for applications
          with larger flash memory or higher safety integrity requirements.
          The trade-off is slightly longer computation time and higher
          memory overhead for storing checksums.

    config IEC60730B_TEST_FLASH_CRC_SEED
        hex "CRC seed value for flash test"
        default 0xFFFFFFFF
        help
          Initial seed value for CRC calculation.
          All 0xFF is standard for most CRC implementations.
          Must match the seed used when pre-calculating the
          expected CRC value.

    endif #IEC60730B_TEST_FLASH

    config IEC60730B_TEST_STACK
        bool "IEC60730B Stack Overflow test routines"
        default y
        help
          Enable stack overflow test routines for the IEC60730B safety library.
          This test monitors stack usage and detects stack overflow conditions
          to ensure system safety and reliability.

    config IEC60730B_TEST_AIO
        bool "IEC60730B Analog Input/Output test routines"
        default y
        select CONFIG_ADC
        help
          Enable Analog Input/Output (AIO) test routines for the IEC60730B safety library.
          This test verifies the integrity of analog input and
          output channels by checking ADC/DAC functionality, reference
          voltages, and signal path integrity. The test helps detect
          stuck-at faults, gain errors, and offset errors in analog
          signal processing circuits.

    config IEC60730B_TEST_CLOCK
        bool "IEC60730B Clock Frequency test routines"
        default y
        select COUNTER
        help
          Enable clock frequency test routines for the IEC60730B safety library.
          This test verifies the integrity and accuracy of system clocks
          by monitoring clock frequency, detecting clock failures, and
          ensuring proper timing for safety-critical operations. The test
          can detect clock source failures, PLL lock issues, and frequency
          drift that could affect system timing requirements.

    config IEC60730B_TEST_CLOCK_LOG_LEVEL
        int "Clock Test Log Level"
        depends on IEC60730B_TEST_CLOCK
        default 0
        range 0 4
        help
          Sets log level for IEC60730B clock test module.
          Levels are: 0 OFF, 1 ERROR, 2 WARNING, 3 INFO, 4 DEBUG

    config IEC60730B_TEST_DIO
        bool "IEC60730B Digital Input/Output test routines"
        default y
        help
          Enable Digital Input/Output (DIO) test routines for the IEC60730B safety library.
          This test verifies the integrity of digital I/O pins
          by checking input/output functionality, pin state detection, and
          proper signal levels. The test can detect stuck-at faults,
          short circuits, open circuits, and other GPIO-related failures
          that could affect safety-critical I/O operations. Includes both
          basic DIO tests and extended DIO functionality tests.

    config IEC60730B_TEST_TSI
        bool "IEC60730B Touch Sensing Interface test routines"
        default y
        help
          Enable Touch Sensing Interface (TSI) test routines for the IEC60730B safety library.
          This test verifies the integrity of capacitive touch
          sensing functionality by checking electrode sensitivity, baseline
          calibration, and touch detection accuracy. The test can detect
          electrode failures, sensitivity drift, noise interference, and
          other touch sensing related failures that could affect safety-
          critical touch interface operations.

    config IEC60730B_TEST_WDOG
        bool "IEC60730B Watchdog Test routines"
        default y
        select HWINFO
        select COUNTER
        select WATCHDOG
        help
          Enable Watchdog Timer test routines for the IEC60730B safety library.
          This test verifies the proper operation of the watchdog timer
          by checking timeout functionality, reset generation, and proper
          refresh mechanisms. The test ensures that the watchdog can detect
          software failures and generate system resets when required for
          safety-critical applications.

    config IEC60730B_TEST_WDOG_LOG_LEVEL
        int "Watchdog Test Log Level"
        depends on IEC60730B_TEST_WDOG
        default 0
        range 0 4
        help
          Sets log level for IEC60730B watchdog test module.
          Levels are: 0 OFF, 1 ERROR, 2 WARNING, 3 INFO, 4 DEBUG

if IEC60730B_HAL_ZEPHYR
rsource "src/hal/zephyr/Kconfig"
endif # IEC60730B_HAL_ZEPHYR

if IEC60730B_HAL_NXP
rsource "src/hal/nxp/Kconfig"
endif # IEC60730B_HAL_NXP

endif # IEC60730B
```

## zephyr/src/hal/nxp/Kconfig
```kconfig
# Copyright 2026 NXP
# SPDX-License-Identifier: Apache-2.0

config IEC60730B_TEST_WDOG_DTCM_NOINIT
    bool "Place watchdog counter variable in DTCM noinit section"
    depends on IEC60730B_TEST_WDOG
    select CODE_DATA_RELOCATION
    default y if (NXP_IMX_EXTERNAL_SDRAM || NXP_IMX_EXTERNAL_HYPERRAM) && DT_HAS_NXP_IMX_DTCM_ENABLED
    help
      On boards where zephyr,sram is external volatile memory (SDRAM,
      HyperRAM, PSRAM), the memory controller is re-initialised on every
      reset, destroying all RAM contents — including __noinit variables.
      This defeats the watchdog test's cross-reset counter persistence.
      When enabled, noinit data is relocated to
      DTCM_NOINIT (on-chip Data TCM), which retains
      its contents across watchdog-triggered resets.
```
